## conf/layer.conf
```bitbake
# We have a conf and classes directory, add to BBPATH
BBPATH .= ":${LAYERDIR}"

# We have recipes-* directories, add to BBFILES
BBFILES += "${LAYERDIR}/recipes-*/*/*.bb \
${LAYERDIR}/recipes-*/*/*.bbappend"

BBFILE_COLLECTIONS += "imx6-autorock"
BBFILE_PATTERN_imx6-autorock = "^${LAYERDIR}/"
BBFILE_PRIORITY_imx6-autorock = "4"
LAYERVERSION_imx6-autorock = "3"

LAYERDEPENDS_imx6-autorock = "core autorock"
```

## conf/machine/imx6dlwisehmi-dashboards-b15a.conf
```bitbake
#@TYPE: Machine
#@NAME: Freescale i.MX6DL WiseHMI
#@SOC: i.MX6DL
#@DESCRIPTION: Machine configuration for Freescale i.MX6DL WiseHMI dashboards board
#@MAINTAINER: wangyinnian <wangyinnian@autorock.com.cn>

require conf/machine/imx6dlwisehmi.inc
 
KERNEL_DEVICETREE = "imx6dl-wisehmi-dashboards-AUO_C123VAN01.dtb"
```

## conf/machine/imx6dlwisehmi-hall.conf
```bitbake
#@TYPE: Machine
#@NAME: Freescale i.MX6DL WiseHMI
#@SOC: i.MX6DL
#@DESCRIPTION: Machine configuration for Project Hall(huatai a25)
#@MAINTAINER: bianshaojun <bianshaojun@autorock.com.cn>

require conf/machine/include/imx6wisehmi-common.inc

SOC_FAMILY = "mx6:mx6dl"

KERNEL_DEVICETREE = "imx6dl-wisehmi-hall.dtb"

UBOOT_CONFIG ??= "sd"
UBOOT_CONFIG[sd] = "mx6dlwisehmi_mmc_spl_smp_defconfig"
UBOOT_CONFIG[nand] = "mx6dlwisehmi_nand_spl_defconfig,ubifs"
```

## conf/machine/imx6dlwisehmi-huatai-b21.conf
```bitbake
#@TYPE: Machine
#@NAME: Freescale i.MX6DL WiseHMI
#@SOC: i.MX6DL
#@DESCRIPTION: Machine configuration for Project huatai b21
#@MAINTAINER: bianshaojun <bianshaojun@autorock.com.cn>

require conf/machine/include/imx6wisehmi-common.inc

SOC_FAMILY = "mx6:mx6dl"

KERNEL_DEVICETREE = "imx6dl-wisehmi-huatai-b21.dtb"

UBOOT_CONFIG ??= "sd"
UBOOT_CONFIG[sd] = "mx6dlwisehmi_mmc_spl_smp_defconfig"
UBOOT_CONFIG[nand] = "mx6dlwisehmi_nand_spl_defconfig,ubifs"
```

## conf/machine/imx6dlwisehmi-lavender-ch.conf
```bitbake
#@TYPE: Machine
#@NAME: Freescale i.MX6DL WiseHMI
#@SOC: i.MX6DL
#@DESCRIPTION: Machine configuration for Project Lavender
#@MAINTAINER: bianshaojun <bianshaojun@autorock.com.cn>

require conf/machine/include/imx6wisehmi-common.inc

SOC_FAMILY = "mx6:mx6dl"

KERNEL_DEVICETREE = "imx6dl-wisehmi-lavender.dtb"

UBOOT_CONFIG ??= "sd"
UBOOT_CONFIG[sd] = "mx6dlwisehmi_ddr128x32_mmc_spl_smp_defconfig"
UBOOT_CONFIG[nand] = "mx6dlwisehmi_nand_spl_defconfig,ubifs"

KERNEL_MODULE_AUTOLOAD += " vfat nls_cp437 nls_iso8859-1 phy-mxs-usb sd_mod usb-storage ci_hdrc_msm ci_hdrc_imx"
MACHINE_ESSENTIAL_EXTRA_RRECOMMENDS += " \
kernel-module-vfat \
kernel-module-nls-cp437 \
kernel-module-nls-iso8859-1 \
kernel-module-phy-mxs-usb \
kernel-module-sd-mod \
kernel-module-usb-storage \
kernel-module-ci-hdrc-msm \
kernel-module-ci-hdrc-imx \
"
```

## conf/machine/imx6dlwisehmi-molihua.conf
```bitbake
#@TYPE: Machine
#@NAME: Freescale i.MX6DL WiseHMI
#@SOC: i.MX6DL
#@DESCRIPTION: Machine configuration for Project Molihua
#@MAINTAINER: chenzilin <chenzilin@autorock.com.cn>

require conf/machine/include/imx6wisehmi-common.inc

SOC_FAMILY = "mx6:mx6dl"

KERNEL_DEVICETREE = "imx6dl-wisehmi-molihua.dtb"

UBOOT_CONFIG ??= "sd"
UBOOT_CONFIG[sd] = "mx6dlwisehmi_mmc_spl_smp_defconfig"
UBOOT_CONFIG[nand] = "mx6dlwisehmi_nand_spl_defconfig,ubifs"

# fs relevant kernel modules
KERNEL_MODULE_AUTOLOAD += "vfat ntfs nls_cp437 nls_iso8859-1"
MACHINE_ESSENTIAL_EXTRA_RRECOMMENDS += " \
kernel-module-vfat \
kernel-module-nls-cp437 \
kernel-module-nls-iso8859-1 \
kernel-module-ntfs \
"

# usb relevant kernel modules
KERNEL_MODULE_AUTOLOAD += "phy-mxs-usb usb-storage sd_mod"
MACHINE_ESSENTIAL_EXTRA_RRECOMMENDS += " \
kernel-module-phy-mxs-usb \
kernel-module-ci-hdrc-imx \
kernel-module-usb-storage \
kernel-module-sd-mod \
"

# tw9990 camera relevant kernel modules
KERNEL_MODULE_AUTOLOAD += "i2c-imx mxc_v4l2_capture tw9990_tvin"
MACHINE_ESSENTIAL_EXTRA_RRECOMMENDS += " \
kernel-module-i2c-imx \
kernel-module-mxc-v4l2-capture \
kernel-module-tw9990-tvin \
"

# wm8960 audio relevant kernel modules
LICENSE_FLAGS_WHITELIST="commercial"
KERNEL_MODULE_AUTOLOAD += "i2c-dev i2c-imx snd-pcm-oss snd-soc-wm8960 \
    snd-soc-fsl-utils snd-soc-fsl-sai snd-soc-fsl-ssi snd-soc-imx-wm8960"
MACHINE_ESSENTIAL_EXTRA_RRECOMMENDS += " \
kernel-module-i2c-dev \
kernel-module-i2c-imx \
kernel-module-snd-pcm-oss \
kernel-module-snd-soc-wm8960 \
kernel-module-snd-soc-fsl-sai \
kernel-module-snd-soc-fsl-ssi \
kernel-module-snd-soc-fsl-utils \
kernel-module-snd-soc-imx-wm8960 \
"
```

## conf/machine/imx6dlwisehmi-tiger.conf
```bitbake
#@TYPE: Machine
#@NAME: Freescale i.MX6DL WiseHMI Tiger board
#@SOC: i.MX6DL
#@DESCRIPTION: Machine configuration for Freescale i.MX6DL WiseHMI Tiger board
#@MAINTAINER: Qiang Yu <yuqiang@autorock.com.cn>

require conf/machine/include/imx6wisehmi-common.inc

SOC_FAMILY = "mx6:mx6dl"

KERNEL_DEVICETREE = "imx6dl-wisehmi-tiger.dtb"

UBOOT_CONFIG ??= "sd"
UBOOT_CONFIG[sd] = "mx6dlwisehmi_mmc_spl_smp_defconfig"
UBOOT_CONFIG[nand] = "mx6dlwisehmi_nand_spl_defconfig,ubifs"

# fs related kernel  modules
KERNEL_MODULE_AUTOLOAD += "vfat ntfs nls_cp437 nls_iso8859-1"
MACHINE_ESSENTIAL_EXTRA_RRECOMMENDS += " \
kernel-module-vfat \
kernel-module-nls-cp437 \
kernel-module-nls-iso8859-1 \
kernel-module-ntfs \
"

# USB related kernel modules
KERNEL_MODULE_AUTOLOAD += "phy-mxs-usb usb-storage sd_mod"
MACHINE_ESSENTIAL_EXTRA_RRECOMMENDS += " \
kernel-module-phy-mxs-usb \
kernel-module-ci-hdrc-imx \
kernel-module-usb-storage \
kernel-module-sd-mod \
"

# TW9990 camera related kernel modules
KERNEL_MODULE_AUTOLOAD += "i2c-imx mxc_v4l2_capture tw9990_tvin"
MACHINE_ESSENTIAL_EXTRA_RRECOMMENDS += " \
kernel-module-i2c-imx \
kernel-module-mxc-v4l2-capture \
kernel-module-tw9990-tvin \
"
```

## conf/machine/imx6dlwisehmi.conf
```bitbake
#@TYPE: Machine
#@NAME: Freescale i.MX6DL WiseHMI
#@SOC: i.MX6DL
#@DESCRIPTION: Machine configuration for Freescale i.MX6DL WiseHMI
#@MAINTAINER: Qiang Yu <yuqiang@autorock.com.cn>

require conf/machine/include/imx6wisehmi-common.inc

SOC_FAMILY = "mx6:mx6dl"

KERNEL_DEVICETREE = "imx6dl-wisehmi.dtb"

UBOOT_CONFIG ??= "sd"
UBOOT_CONFIG[sd] = "mx6dlwisehmi_mmc_spl_smp_defconfig"
UBOOT_CONFIG[nand] = "mx6dlwisehmi_nand_spl_defconfig,ubifs"
```

## conf/machine/imx6dlwisehmi.inc
```bitbake
#@TYPE: Machine
#@NAME: Freescale i.MX6Q WiseHMI
#@SOC: i.MX6DL
#@DESCRIPTION: Machine configuration for Freescale i.MX6DL WiseHMI
#@MAINTAINER: Wang Yinnian <wangyinnian@autorock.com.cn>

require conf/machine/include/imx6wisehmi-common.inc

SOC_FAMILY = "mx6:mx6dl"

KERNEL_DEVICETREE = "imx6dl-wisehmi-dashboards.dtb"

UBOOT_CONFIG ??= "sd"
UBOOT_CONFIG[sd] = "mx6dlwisehmi_ddr128x32_mmc_spl_smp_defconfig"
UBOOT_CONFIG[nand] = "mx6dlwisehmi_nand_spl_defconfig,ubifs"

# fs related kernel  modules
KERNEL_MODULE_AUTOLOAD += "vfat nls_cp437 nls_iso8859-1"
MACHINE_ESSENTIAL_EXTRA_RRECOMMENDS += " \
kernel-module-vfat \
kernel-module-nls-cp437 \
kernel-module-nls-iso8859-1 \
"

# USB related kernel modules
KERNEL_MODULE_AUTOLOAD += "phy-mxs-usb ci_hdrc_imx usb-storage sd_mod"
MACHINE_ESSENTIAL_EXTRA_RRECOMMENDS += " \
kernel-module-phy-mxs-usb \
kernel-module-ci-hdrc-imx \
kernel-module-usb-storage \
kernel-module-sd-mod \
"
```

## conf/machine/imx6qwisehmi-carnation-b70.conf
```bitbake
#@TYPE: Machine
#@NAME: Freescale i.MX6Q WiseHMI
#@SOC: i.MX6Q
#@DESCRIPTION: Machine configuration for Freescale i.MX6Q WiseHMI
#@MAINTAINER: Li Hao <lihao@autorock.com.cn>

require conf/machine/include/imx6wisehmi-common.inc

SOC_FAMILY = "mx6:mx6q"

#KERNEL_DEVICETREE = "imx6q-wisehmi-carnation_b70.dtb"
KERNEL_DEVICETREE = "imx6q-wisehmi-tiger_auo123.dtb"

UBOOT_CONFIG ??= "sd"
UBOOT_CONFIG[sd] = "mx6qwisehmi_mmc_spl_smp_defconfig"
UBOOT_CONFIG[nand] = "mx6qwisehmi_nand_spl_defconfig,ubifs"
```

## conf/machine/imx6qwisehmi-tiger-hsd7.conf
```bitbake
#@TYPE: Machine
#@NAME: Freescale i.MX6Q WiseHMI
#@SOC: i.MX6Q
#@DESCRIPTION: Machine configuration for Project tiger-hsd7
#@MAINTAINER: wangyinnian <wangyinnian@autorock.com.cn>

require conf/machine/imx6qwisehmi.inc
 
#UBOOT_CONFIG[sd] = "mx6qsmarthmi_ddr128x64_mmc_spl_defconfig"

KERNEL_DEVICETREE = "imx6q-wisehmi-tiger_hsd7.dtb"
```

## conf/machine/imx6qwisehmi-tiger-hud.conf
```bitbake
#@TYPE: Machine
#@NAME: Freescale i.MX6Q WiseHMI
#@SOC: i.MX6Q
#@DESCRIPTION: Machine configuration for Project tiger-hud
#@MAINTAINER: wangyinnian <wangyinnian@autorock.com.cn>

require conf/machine/imx6qwisehmi.inc

KERNEL_DEVICETREE = "imx6q-wisehmi-tiger_auo123+hudTFT9K2353.dtb"
```

## conf/machine/imx6qwisehmi.conf
```bitbake
#@TYPE: Machine
#@NAME: Freescale i.MX6DL WiseHMI
#@SOC: i.MX6DL
#@DESCRIPTION: Machine configuration for Freescale i.MX6DL WiseHMI
#@MAINTAINER: Qiang Yu <yuqiang@autorock.com.cn>

require conf/machine/include/imx6wisehmi-common.inc

SOC_FAMILY = "mx6:mx6q"

KERNEL_DEVICETREE = "imx6q-wisehmi.dtb"

UBOOT_CONFIG ??= "sd"
UBOOT_CONFIG[sd] = "mx6qwisehmi_mmc_spl_defconfig"
UBOOT_CONFIG[nand] = "mx6qwisehmi_nand_spl_defconfig,ubifs"
```

## conf/machine/include/imx6wisehmi-common.inc
```bitbake
# Provides the i.MX6 WiseHMI common settings

MACHINEOVERRIDES = "wisehmi:${MACHINE}"
MACHINE_CLASS = "wisehmi"

require conf/machine/include/imx-base.inc
require conf/machine/include/tune-cortexa9.inc

SERIAL_CONSOLE = "115200 ttymxc3"

PREFERRED_PROVIDER_u-boot = "u-boot-imx6-autorock"
#PREFERRED_VERSION_u-boot-imx6-autorock = "2014.10"

PREFERRED_PROVIDER_virtual/kernel = "linux-imx6-autorock"
#PREFERRED_VERSION_linux-imx6-autorock = "3.10.17"

PREFERRED_PROVIDER_jpeg = "libjpeg-turbo"

KERNEL_IMAGETYPE = "zImage"

IMAGE_FSTYPES = "tar.bz2"

MACHINE_FEATURES_remove = "usbgadget usbhost alsa touchscreen"

# remove getty tty* from /etc/inittab
USE_VT = "0"

SPL_BINARY = "SPL"
UBOOT_SUFFIX = "img"
UBOOT_MAKE_TARGET = "all"

KERNEL_MODULE_AUTOLOAD += "vfat af_packet fec mii smsc"
MACHINE_ESSENTIAL_EXTRA_RRECOMMENDS += " \
kernel-module-vfat \
kernel-module-af_packet \
kernel-module-fec \
kernel-module-mii \
kernel-module-smsc \
"
```

## recipes-kernel/linux/linux-imx6-autorock/wisehmi/defconfig
```kconfig
CONFIG_KERNEL_LZ4=y
CONFIG_SYSVIPC=y
CONFIG_NO_HZ=y
CONFIG_HIGH_RES_TIMERS=y
CONFIG_IKCONFIG=y
CONFIG_IKCONFIG_PROC=y
CONFIG_LOG_BUF_SHIFT=18
CONFIG_CGROUPS=y
CONFIG_RELAY=y
CONFIG_BLK_DEV_INITRD=y
# CONFIG_RD_GZIP is not set
# CONFIG_RD_BZIP2 is not set
# CONFIG_RD_LZMA is not set
# CONFIG_RD_XZ is not set
# CONFIG_RD_LZO is not set
CONFIG_EXPERT=y
CONFIG_KALLSYMS_ALL=y
CONFIG_PERF_EVENTS=y
# CONFIG_SLUB_DEBUG is not set
# CONFIG_COMPAT_BRK is not set
CONFIG_SUPPORT_INITROOT=y
CONFIG_UBOOT_SMP_BOOT=y
CONFIG_MODULES=y
CONFIG_MODULE_UNLOAD=y
CONFIG_MODVERSIONS=y
CONFIG_MODULE_SRCVERSION_ALL=y
# CONFIG_BLK_DEV_BSG is not set
CONFIG_ARCH_MXC=y
CONFIG_SOC_IMX6Q=y
# CONFIG_SWP_EMULATE is not set
CONFIG_ARM_ERRATA_814220=y
CONFIG_SMP=y
CONFIG_HAVE_ARM_ARCH_TIMER=y
CONFIG_VMSPLIT_2G=y
CONFIG_PREEMPT=y
CONFIG_AEABI=y
CONFIG_HIGHMEM=y
CONFIG_CMA=y
CONFIG_CMDLINE="noinitrd console=ttymxc0,115200"
CONFIG_CPU_FREQ=y
CONFIG_CPU_FREQ_DEFAULT_GOV_ONDEMAND=y
CONFIG_CPU_FREQ_GOV_POWERSAVE=y
CONFIG_CPU_FREQ_GOV_USERSPACE=y
CONFIG_CPU_FREQ_GOV_INTERACTIVE=y
CONFIG_CPU_FREQ_GOV_CONSERVATIVE=y
CONFIG_ARM_IMX6Q_CPUFREQ=y
CONFIG_CPU_IDLE=y
CONFIG_VFP=y
CONFIG_NEON=y
CONFIG_BINFMT_MISC=m
CONFIG_PM_DEBUG=y
CONFIG_PM_TEST_SUSPEND=y
CONFIG_NET=y
CONFIG_PACKET=y
CONFIG_UNIX=y
CONFIG_INET=y
CONFIG_IP_PNP=y
CONFIG_IP_PNP_DHCP=y
# CONFIG_INET_XFRM_MODE_TRANSPORT is not set
# CONFIG_INET_XFRM_MODE_TUNNEL is not set
# CONFIG_INET_XFRM_MODE_BEET is not set
# CONFIG_INET_LRO is not set
# CONFIG_IPV6 is not set
CONFIG_VLAN_8021Q=y
CONFIG_LLC2=y
CONFIG_CAN=y
CONFIG_CAN_FLEXCAN=y
CONFIG_CFG80211=m
# CONFIG_CFG80211_DEFAULT_PS is not set
CONFIG_DEVTMPFS=y
CONFIG_DEVTMPFS_MOUNT=y
# CONFIG_STANDALONE is not set
CONFIG_DMA_CMA=y
CONFIG_CMA_SIZE_MBYTES=0
CONFIG_IMX_WEIM=y
CONFIG_CONNECTOR=y
CONFIG_BLK_DEV_LOOP=y
CONFIG_BLK_DEV_RAM=y
CONFIG_BLK_DEV_RAM_SIZE=65536
CONFIG_EEPROM_AT24=m
CONFIG_SCSI=m
# CONFIG_SCSI_PROC_FS is not set
CONFIG_BLK_DEV_SD=m
# CONFIG_SCSI_LOWLEVEL is not set
CONFIG_NETDEVICES=y
# CONFIG_NET_VENDOR_ARC is not set
# CONFIG_NET_CADENCE is not set
# CONFIG_NET_VENDOR_BROADCOM is not set
# CONFIG_NET_VENDOR_CIRRUS is not set
# CONFIG_NET_VENDOR_FARADAY is not set
CONFIG_FEC=m
# CONFIG_NET_VENDOR_HISILICON is not set
# CONFIG_NET_VENDOR_INTEL is not set
# CONFIG_NET_VENDOR_MARVELL is not set
# CONFIG_NET_VENDOR_MICREL is not set
# CONFIG_NET_VENDOR_NATSEMI is not set
# CONFIG_NET_VENDOR_QUALCOMM is not set
# CONFIG_NET_VENDOR_ROCKER is not set
# CONFIG_NET_VENDOR_SAMSUNG is not set
# CONFIG_NET_VENDOR_SEEQ is not set
# CONFIG_NET_VENDOR_SMSC is not set
# CONFIG_NET_VENDOR_STMICRO is not set
# CONFIG_NET_VENDOR_VIA is not set
# CONFIG_NET_VENDOR_WIZNET is not set
CONFIG_PHYLIB=y
CONFIG_SMSC_PHY=m
# CONFIG_USB_NET_DRIVERS is not set
CONFIG_USB_ZD1201=m
# CONFIG_INPUT_MOUSEDEV is not set
CONFIG_INPUT_EVDEV=m
# CONFIG_INPUT_KEYBOARD is not set
# CONFIG_INPUT_MOUSE is not set
# CONFIG_SERIO is not set
# CONFIG_CONSOLE_TRANSLATIONS is not set
# CONFIG_LEGACY_PTYS is not set
# CONFIG_DEVKMEM is not set
CONFIG_SERIAL_IMX=y
CONFIG_SERIAL_IMX_CONSOLE=y
CONFIG_SERIAL_FSL_LPUART=y
CONFIG_SERIAL_FSL_LPUART_CONSOLE=y
CONFIG_FSL_OTP=y
CONFIG_HW_RANDOM=y
# CONFIG_I2C_COMPAT is not set
CONFIG_I2C_CHARDEV=y
# CONFIG_I2C_HELPER_AUTO is not set
CONFIG_I2C_ALGOBIT=y
CONFIG_I2C_ALGOPCF=m
CONFIG_I2C_ALGOPCA=m
CONFIG_I2C_IMX=y
CONFIG_PTP_1588_CLOCK=y
CONFIG_GPIO_SYSFS=y
CONFIG_POWER_SUPPLY=y
CONFIG_POWER_RESET=y
CONFIG_POWER_RESET_SYSCON_POWEROFF=y
# CONFIG_HWMON is not set
CONFIG_THERMAL=y
CONFIG_CPU_THERMAL=y
CONFIG_IMX_THERMAL=y
CONFIG_DEVICE_THERMAL=y
CONFIG_WATCHDOG=y
CONFIG_IMX2_WDT=y
CONFIG_REGULATOR=y
CONFIG_REGULATOR_FIXED_VOLTAGE=y
CONFIG_REGULATOR_ANATOP=y
CONFIG_REGULATOR_GPIO=y
CONFIG_REGULATOR_PFUZE100=y
CONFIG_MEDIA_SUPPORT=y
CONFIG_MEDIA_CAMERA_SUPPORT=y
CONFIG_V4L_PLATFORM_DRIVERS=y
CONFIG_VIDEO_MXC_CAPTURE=y
CONFIG_MXC_TVIN_TW9990=y
CONFIG_MXC_IPU_DEVICE_QUEUE_SDC=y
CONFIG_FB=y
# CONFIG_FB_MX3 is not set
CONFIG_FB_MXC_SYNC_PANEL=y
CONFIG_FB_MXC_LDB=y
# CONFIG_FB_MXC_EDID is not set
CONFIG_BACKLIGHT_LCD_SUPPORT=y
# CONFIG_LCD_CLASS_DEVICE is not set
CONFIG_BACKLIGHT_CLASS_DEVICE=y
# CONFIG_BACKLIGHT_GENERIC is not set
CONFIG_BACKLIGHT_PWM=y
CONFIG_SOUND=y
CONFIG_SND=y
# CONFIG_SND_SUPPORT_OLD_API is not set
# CONFIG_SND_VERBOSE_PROCFS is not set
# CONFIG_SND_DRIVERS is not set
# CONFIG_SND_ARM is not set
# CONFIG_SND_USB is not set
CONFIG_SND_SOC=y
CONFIG_SND_SOC_FSL_SSI=y
CONFIG_SND_SOC_IMX_AUDMUX=y
CONFIG_SND_IMX_SOC=y
CONFIG_SND_SOC_IMX_WM8960=y
# CONFIG_HID is not set
# CONFIG_USB_HID is not set
CONFIG_USB=m
# CONFIG_USB_DEFAULT_PERSIST is not set
CONFIG_USB_EHCI_HCD=m
CONFIG_USB_EHCI_MXC=m
CONFIG_USB_STORAGE=m
CONFIG_USB_CHIPIDEA=m
CONFIG_USB_CHIPIDEA_HOST=y
CONFIG_USB_MXS_PHY=m
CONFIG_MMC=y
CONFIG_MMC_SDHCI=y
CONFIG_MMC_SDHCI_PLTFM=y
CONFIG_MMC_SDHCI_ESDHC_IMX=y
CONFIG_MXC_IPU=y
CONFIG_MXC_IPU_V3_PRE=y
CONFIG_MXC_GPU_VIV=y
# CONFIG_MXC_VPU is not set
CONFIG_RTC_CLASS=y
CONFIG_RTC_INTF_DEV_UIE_EMUL=y
CONFIG_RTC_DRV_MXC=y
CONFIG_RTC_DRV_SNVS=y
CONFIG_DMADEVICES=y
CONFIG_MXC_PXP_V2=y
CONFIG_MXC_PXP_V3=y
CONFIG_IMX_SDMA=y
CONFIG_MXS_DMA=y
CONFIG_DMATEST=m
CONFIG_STAGING=y
CONFIG_STAGING_MEDIA=y
# CONFIG_IOMMU_SUPPORT is not set
CONFIG_PWM=y
CONFIG_PWM_IMX=y
CONFIG_EXT4_FS=y
CONFIG_EXT4_FS_POSIX_ACL=y
CONFIG_EXT4_FS_SECURITY=y
CONFIG_MSDOS_FS=m
CONFIG_VFAT_FS=m
CONFIG_TMPFS=y
CONFIG_CONFIGFS_FS=m
# CONFIG_MISC_FILESYSTEMS is not set
# CONFIG_NETWORK_FILESYSTEMS is not set
CONFIG_NLS=y
CONFIG_NLS_DEFAULT="cp437"
CONFIG_NLS_CODEPAGE_437=m
CONFIG_NLS_ASCII=m
CONFIG_NLS_ISO8859_1=m
CONFIG_NLS_UTF8=m
CONFIG_PRINTK_TIME=y
# CONFIG_ENABLE_WARN_DEPRECATED is not set
# CONFIG_ENABLE_MUST_CHECK is not set
# CONFIG_SCHED_DEBUG is not set
# CONFIG_DEBUG_PREEMPT is not set
# CONFIG_DEBUG_BUGVERBOSE is not set
# CONFIG_FTRACE is not set
# CONFIG_ARM_UNWIND is not set
CONFIG_CRYPTO_DEFLATE=y
CONFIG_CRYPTO_LZO=y
# CONFIG_CRYPTO_ANSI_CPRNG is not set
# CONFIG_CRYPTO_HW is not set
CONFIG_VIRTUALIZATION=y
```
